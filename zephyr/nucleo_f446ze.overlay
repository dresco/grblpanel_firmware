/*
 * Copyright (c) 2020 Phytec Messtechnik GmbH
 *
 * SPDX-License-Identifier: Apache-2.0
 */

 &usart2 {
    status = "okay";

    modbus0 {
        compatible = "zephyr,modbus-serial";
        label = "MODBUS0";
        status = "okay";
    };
};