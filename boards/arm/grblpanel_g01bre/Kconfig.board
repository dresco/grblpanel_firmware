## boards/arm/grblpanel_g01bre/Kconfig.board
```kconfig
# STM32 Nucleo-64 development board with STM32G0B1RE MCU configuration

# Copyright (c) 2019 Thomas Stranger
# SPDX-License-Identifier: Apache-2.0

config BOARD_GRBLPANEL_G0B1RE
    bool "grblPANEL G0B1RE Reference Board"
    depends on SOC_STM32G0B1XX
```

## boards/arm/grblpanel_g01bre/Kconfig.defconfig
```kconfig
# grblPANEL reference board with STM32G0B1RE MCU

# Copyright (c) 2020 Thomas Stranger
# SPDX-License-Identifier: Apache-2.0

if BOARD_GRBLPANEL_G0B1RE

config BOARD
    default "grblpanel_g0b1re"

endif # BOARD_GRBLPANEL_G0B1RE
```

## drivers/Kconfig
```kconfig
# Copyright (c) 2022 Jon Escombe
# SPDX-License-Identifier: MIT

rsource "sensor/Kconfig"
```

## drivers/sensor/Kconfig
```kconfig
# Copyright (c) 2022 Jon Escombe
# SPDX-License-Identifier: MIT

rsource "encoder_stm32/Kconfig"
```

## drivers/sensor/encoder_stm32/Kconfig
```kconfig
# Copyright (c) 2022 Jon Escombe
# SPDX-License-Identifier: Apache-2.0

menuconfig ENCODER_STM32
    bool "STM32 quadrature encoder"
    default n
    depends on DT_HAS_ST_STM32_ENCODER_ENABLED
    select USE_STM32_LL_TIM
    help
      STM32 Quadrature Encoder driver.
```

## zephyr/Kconfig
```kconfig
mainmenu "MYAPP"

source "Kconfig.zephyr"
config MYAPP_STM32
  default y
  bool
    select USE_STM32_LL_GPIO
    select USE_STM32_LL_TIM
```
